

;***********************  VALORI DA IMPOSTAZIONE  *************************
;La tabella di conversione di temperatura si trova in EQUIVALENZE.INC
;***********************  VALORI DA IMPOSTAZIONE  *************************

 ;PRE RISCALDAMENTO
TEMPO_PR	EQU	.60		;IN SECONDI, 1÷255
T_PR		EQU	T_100	;SOGLIA NTC, 0÷1023

 ;FASE1
TIME1			EQU	.360	;IN SECONDI, 1÷15300
REDUCED_TIME1	EQU	(TIME1 - TEMPO_PR)	;when starting at a temperature > T_PR
T1				EQU	T_190	;SOGLIA NTC, 0÷1023, 


;FASE2
TIME2		EQU	.180	;IN SECONDI, 1÷255
T2			EQU	T_170	;SOGLIA NTC, 0÷1023

;FASE3
TIME3		EQU	.180	;IN SECONDI, 1÷255
T3			EQU	T_130	;SOGLIA NTC, 0÷1023 

;FASE4
T4			EQU	T_150	;SOGLIA NTC, 0÷1023

TP			EQU	.40	;PASSI DA 0”065536 (1÷255) (0”065536÷16"71168) - TEMPO
					;	ANTI RIMBALZO TASTO PREMUTO


TEMPO_Y		EQU	.30	;IN MINUTI, 1÷255


	IF	T1<1 || T1>.1023
	ERROR	'**ERRORE FILE DI UTENZA:  T1 OUT OF RANGE **'
	ENDIF

	IF	T2<1 || T2>.1023
	ERROR	'**ERRORE FILE DI UTENZA:  T2 OUT OF RANGE **'
	ENDIF

	IF	T3<1 || T3>.1023
	ERROR	'**ERRORE FILE DI UTENZA:  T3 OUT OF RANGE **'
	ENDIF

	IF	T4<1 || T4>.1023
	ERROR	'**ERRORE FILE DI UTENZA:  T4 OUT OF RANGE **'
	ENDIF

	IF	TP<1 || TP>.255
	ERROR	'**ERRORE FILE DI UTENZA:  TP OUT OF RANGE **'
	ENDIF

	IF	TIME1<1 || TIME1>.15300
	ERROR	'**ERRORE FILE DI UTENZA:  TIME1 OUT OF RANGE **'
	ENDIF

	IF	TIME1<2 || TIME2>.255
	ERROR	'**ERRORE FILE DI UTENZA:  TIME2 OUT OF RANGE **'
	ENDIF

	IF	TIME1<3 || TIME3>.255
	ERROR	'**ERRORE FILE DI UTENZA:  TIME3 OUT OF RANGE **'
	ENDIF

	IF	TEMPO_Y < ((TIME1+TIME2+TIME3)/.60) || TEMPO_Y >.255
	ERROR	'**ERRORE FILE DI UTENZA:  TEMPO_Y OUT OF RANGE **'
	ENDIF

;*******************************
