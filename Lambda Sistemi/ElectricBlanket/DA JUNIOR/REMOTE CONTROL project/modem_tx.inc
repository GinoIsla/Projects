
;++++++++++++++++++++++++++++++++++++++++++++++++++++++++++++++++
;TRASMISSIONE HCS

;BUFFER DI TRASMISSIONE

;MODEM1 CONTIENE ID HI POLIOPTO
;MODEM2 CONTIENE ID MI POLIOPTO
;MODEM3 CONTIENE ID LO POLIOPTO
;MODEM4 CONTIENE SERIAL NUMBER HI
;MODEM5 CONTIENE SERIAL NUMBER LO
;****************************************************************
	CBLOCK	;0xA2
FLAGS_MODEM
FLAGS_MODEM2

; BUFFER DI TRASMISSIONE HCS
HCS1			;ROLLING CODE
HCS2			;ROLLING CODE
HCS3			;DISCRIMINANTE (LSB)
HCS4			;7:4 CHANNELS, 3:2 OVERFLOW BITS (UNUSED), DISCRIMINANTE (LSB)
HCS5			;SERIAL NUMBER (LSB)
HCS6			;SERIAL NUMBER
HCS7			;SERIAL NUMBER (MSB)
HCS8			;7:4 CHANNELS CODE (S2, S1, S0, S3)
HCS9			;1 REPEAT, 0 LOW BATT

COUNTER
COUNT1
TEMP100
TEMP200
TEMP10
TEMP20
TEMP30

CARICA_TIMER_HCS_HI
CARICA_TIMER_HCS_LO
	ENDC


;-- ALIAS -------------------------------------------------------------
HOP_LO	EQU	HCS1	; CONTATORE ROLLING CODE LSB
HOP_HI	EQU	HCS2 	; CONTATORE ROLLING CODE MSB 
DIS_LO	EQU	HCS3 	; DISCRIMINANTE LSB
DOK	EQU	HCS4 	; DISCRIMINANTE MSB + EVERFLOW + KEY CODE
ID_LO	EQU	HCS5 	; SERIAL NUMBER LSB
ID_MI	EQU	HCS6 	; SERIAL NUMBER 
ID_HI	EQU	HCS7 	; SERIAL NUMBER MSB
ID_UP	EQU	HCS8 	; SERIAL NUMBER MSB


#DEFINE	S0	DOK,5	; CODICI CANALE 
#DEFINE	S1	DOK,6
#DEFINE	S2	DOK,7
#DEFINE	S3	DOK,4

;****** RE-DEFINE PORTA *****************************************
#DEFINE	PIN_MODEM	PORTA,0	;PIN DI TRASMISSIONE MODEM

;****** FLAGS_MODEM *****************************************
#DEFINE	GATE_FASE_1	FLAGS_MODEM,0	;APERTURA  FASE 1 DELLA TRASMISSIONE MODEM (PREAMBOLO)
#DEFINE	GATE_FASE_2	FLAGS_MODEM,1	;APERTURA  FASE 2 DELLA TRASMISSIONE MODEM (HEADER)
#DEFINE	GATE_FASE_3	FLAGS_MODEM,2	;APERTURA  FASE 1 DELLA TRASMISSIONE MODEM (HOPPING)
#DEFINE	TE1		FLAGS_MODEM,3	;TRASMISSIONE DEL BIT ALTO DELL'HOPPING
#DEFINE	TE2		FLAGS_MODEM,4	;TRASMISSIONE DEL BIT ALTO/BASSO DELL'HOPPING
#DEFINE	TE3		FLAGS_MODEM,5	;TRASMISSIONE DEL BIT BASSO DELL'HOPPING
#DEFINE	GATE_1_APERTO	FLAGS_MODEM,6	;APERTURA DI GATE 1
#DEFINE	GATE_2_APERTO	FLAGS_MODEM,7	;APERTURA DI GATE 2

;****** FLAGS_MODEM2 *****************************************
;#DEFINE	TRASMISSIONE	FLAGS2_MODEM,0	;ABILITAZIONE ALLA TRASMISSIONE MODEM
#DEFINE	ALTO1_BASSO0	FLAGS_MODEM2,1	;FLAG DA INVERTIRE CHE DETERMINA TE2

;*******************************************************

;*******************************************************
INIZIO_TX
	SET	TX_ATTIVA

	BANK1
	MOVFW	BUFFER1
	MOVWF	MODEM1
	MOVFW	BUFFER2
	MOVWF	MODEM2
	MOVFW	BUFFER3
	MOVWF	MODEM3
	MOVFW	BUFFER4
	MOVWF	MODEM4
	MOVFW	BUFFER5
	MOVWF	MODEM5

	MOVLW	.0
	MOVWF	FASE_TX
	MOVLW	COUNTER_TX
	MOVWF	COUNTER
	MOVLW	.23
	MOVWF	COUNTER_PREAMBOLO

	CALL	SET_TMR_TX

IT_X	BANK0
	PAG0
	;B	MILO2
;*******************************************************


;*******************************************************
FASE_1	BANK0
	MOVLW	08H		;TRASMISSIONE PREAMBOLO
	XORWF	PORTA,F

	BANK1
	DECFSZ	COUNTER_PREAMBOLO,F
	B	F1_X

	MOVLW	.10
	MOVWF	COUNTER_HEADER
	INCF	FASE_TX,F
	SET	GATE_1_APERTO
	SET	GATE_2_APERTO

F1_X	B	I30
;*******************************************************


;*******************************************************
FASE_HEADER
	BANK0
	CANC	PIN_MODEM		;TRASMISSIONE HEADER
	BANK1

	DECFSZ	COUNTER_HEADER,F
	B	F2_X

	MOVLW	.66			;66 NORMALMENTE, A VOLTE SOLO SOLO 64
	MOVWF	COUNTER_DATA
	INCF	FASE_TX,F
	SET	TE1

F2_X	B	I30
;*******************************************************


;*******************************************************
FASE_3	BANK0
	SET	PIN_MODEM
	BANK1

	INCF	FASE_TX,F
	B	F3_X

F3_A	CALL	CALCOLA_PIN		;IL PIN ARRIVA ALTO...

F3_C	SS	ALTO1_BASSO0		;...SE DEVO TRASMETTERE 1... 
	B	F3_D

	BANK0
	CANC	PIN_MODEM		;...LO INVERTO,...
					;...SE DEVO TRASMETTERE 0 LO LASCIO ALTO
F3_D	BANK1
	INCF	FASE_TX,F
	B	F3_X

F3_B	BANK0
	CANC	PIN_MODEM
	BANK1

	INCF	FASE_TX,F
	
	DECFSZ	TEMP100,F
	B	F3_X

	CLRF	FASE_TX,F

	BANK0
	CANC	TRASMISSIONE
	CANC	TX_ATTIVA
	BANK1

	CALL	CANC_TMR_TX

F3_X	B	I30
;*******************************************************


;*******************************************************
CALCOLA_PIN
GATE_1	SS	GATE_1_APERTO
	B	GATE_2

	MOVLW	MODEM1
	MOVWF	FSR
	CANC	GATE_1_APERTO

GATE_2	SS	GATE_2_APERTO
	B	GATE_3

	MOVLW	.8
	MOVWF	COUNT1
	MOVFW	INDF
	MOVWF	TEMP200
	CANC	GATE_2_APERTO

GATE_3	CANC	ALTO1_BASSO0
	SC	TEMP200,0
	SET	ALTO1_BASSO0

	CLRC
	RRF	TEMP200,F
	DECFSZ	COUNT1,F
	B	CP_X

	INCF	FSR,F
	SET	GATE_2_APERTO

CP_X	RETURN
;*******************************************************


;*******************************************************
SET_TMR_TX
	RETURN
;*******************************************************



;*******************************************************
CANC_TMR_TX
	RETURN
;*******************************************************

;*******************************************************
GESTIONE_TMR_HCS
	DECFSZ	COUNTER,F
	B	I30

	MOVLW	COUNTER_TX
	MOVWF	COUNTER

	SC	GATE_FASE_1
	B	FASE_1

	SS	TRASMISSIONE
	B	I30

I10	SC	GATE_FASE_2
	B	FASE_2

I20	SC	GATE_FASE_3
	B	FASE_3

I30	B	I1			;RETURN A INTERRUPT
;*******************************************************

